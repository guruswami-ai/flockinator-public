## firmware/korvo-monitor/main/Kconfig.projbuild
```kconfig
menu "Korvo monitor"

config KORVO_EMBED_SPEECH
    bool "Embed operator-supplied speech samples"
    default n
    help
        Embed the ten PCM files described in main/speech/README.md and seed
        missing samples on the SD card. These files are not distributed.
        When disabled, existing SD samples can still play; missing samples
        fall back to the event tone.

endmenu
```

## firmware/korvo-monitor/sdkconfig.defaults
```kconfig
# Public ESP32-S31 Korvo hardware/build settings; no provisioning data.
CONFIG_IDF_TARGET="esp32s31"
CONFIG_ESPTOOLPY_FLASHMODE_QIO=y
CONFIG_ESPTOOLPY_FLASHSIZE_16MB=y
CONFIG_PARTITION_TABLE_CUSTOM=y
CONFIG_PARTITION_TABLE_CUSTOM_FILENAME="partitions.csv"
CONFIG_COMPILER_OPTIMIZATION_PERF=y
CONFIG_SPIRAM=y
CONFIG_SPIRAM_SPEED_250M=y
CONFIG_SPIRAM_XIP_FROM_PSRAM=y
CONFIG_SPIRAM_MALLOC_ALWAYSINTERNAL=256
CONFIG_FREERTOS_HZ=1000
CONFIG_LV_FONT_MONTSERRAT_18=y
CONFIG_LV_FONT_MONTSERRAT_24=y
CONFIG_LV_FONT_MONTSERRAT_32=y
```
